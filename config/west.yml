## config/west.yml
```yaml
manifest:
  defaults:
    revision: main
  remotes:
    - name: zmkfirmware
      url-base: https://github.com/zmkfirmware
    - name: Good-Great-Grand-Wonderful
      url-base: https://github.com/Good-Great-Grand-Wonderful
  projects:
    - name: zmk
      remote: zmkfirmware
      revision: ac7f75b8591d39aaf3b66b9d26f26c9ed921a009
      import: app/west.yml
    - name: gggw-zmk-keebs
      remote: Good-Great-Grand-Wonderful
      # Pinned: later commits bump rgbled-widget to an API our pinned ZMK lacks
      revision: 051dbd8d96aa18a997705526bb7e03460e310496
      import: config/west.yml
  self:
    path: config
```
